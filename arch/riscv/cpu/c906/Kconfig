## arch/riscv/cpu/c906/Kconfig
```kconfig
# SPDX-License-Identifier: GPL-2.0+

config THEAD_C906
	bool
	select SYS_CACHE_SHIFT_6
```

## configs/mangopi_mq_pro_defconfig
```kconfig
CONFIG_RISCV=y
CONFIG_SYS_MALLOC_LEN=0x220000
CONFIG_SPL_GPIO=y
CONFIG_HAS_CUSTOM_SYS_INIT_SP_ADDR=y
CONFIG_CUSTOM_SYS_INIT_SP_ADDR=0x43e00000
CONFIG_ENV_SIZE=0x10000
CONFIG_DM_GPIO=y
CONFIG_DEFAULT_DEVICE_TREE="allwinner/sun20i-d1-mangopi-mq-pro"
CONFIG_OF_LIBFDT_OVERLAY=y
CONFIG_SPL_MMC=y
CONFIG_SPL=y
CONFIG_PRE_CON_BUF_ADDR=0x43000000
CONFIG_DRAM_SUNXI_ODT_EN=0x1
CONFIG_DRAM_SUNXI_TPR0=0x004a2195
CONFIG_DRAM_SUNXI_TPR11=0x00870000
CONFIG_DRAM_SUNXI_TPR12=0x00000024
CONFIG_DRAM_SUNXI_TPR13=0x34050100
CONFIG_SPL_DRAM_SUNXI_DEBUG=y
CONFIG_TARGET_SUN20I_D1=y
CONFIG_MANGOPI_MQ_PRO=y
CONFIG_RISCV_SMODE=y
# CONFIG_SPL_SMP is not set
# CONFIG_LOCALVERSION_AUTO is not set
CONFIG_FIT=y
CONFIG_DISTRO_DEFAULTS=y
CONFIG_OF_BOARD_SETUP=y
CONFIG_USE_PREBOOT=y
CONFIG_PRE_CONSOLE_BUFFER=y
CONFIG_CONSOLE_MUX=y
CONFIG_SPL_PAD_TO=0x27fa0
CONFIG_SPL_SYS_MALLOC=y
CONFIG_SPL_POWER=y
CONFIG_SPL_OPENSBI_SCRATCH_OPTIONS=0x0
CONFIG_CMD_BIND=y
CONFIG_CMD_GPIO=y
CONFIG_CMD_GPT=y
CONFIG_CMD_MMC=y
CONFIG_CMD_USB=y
CONFIG_CMD_CLS=y
CONFIG_OF_UPSTREAM=y
CONFIG_ENV_IS_IN_FAT=y
CONFIG_ENV_FAT_DEVICE_AND_PART="0:auto"
# CONFIG_NET is not set
CONFIG_SPL_CLK=y
CONFIG_SUNXI_GPIO=y
CONFIG_DM_I2C=y
CONFIG_MMC=y
CONFIG_PINCTRL=y
CONFIG_SPL_PINCTRL=y
CONFIG_SPL_PINCONF=y
CONFIG_DM_REGULATOR_FIXED=y
CONFIG_RAM=y
CONFIG_SPL_RAM=y
CONFIG_SYS_NS16550=y
CONFIG_SYSRESET=y
CONFIG_SYSRESET_WATCHDOG=y
CONFIG_SYSRESET_WATCHDOG_AUTO=y
CONFIG_USB=y
CONFIG_USB_EHCI_HCD=y
CONFIG_USB_EHCI_GENERIC=y
CONFIG_USB_OHCI_HCD=y
CONFIG_USB_OHCI_GENERIC=y
CONFIG_USB_KEYBOARD=y
```
